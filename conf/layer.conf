## conf/layer.conf
```bitbake
# We have a conf and classes directory, add to BBPATH
BBPATH .= ":${LAYERDIR}"

# We have recipes-* directories, add to BBFILES
BBFILES += "${LAYERDIR}/recipes-*/*/*.bb \
            ${LAYERDIR}/recipes-*/*/*.bbappend"

BBFILE_COLLECTIONS += "meta-alencon"
BBFILE_PATTERN_meta-alencon = "^${LAYERDIR}/"
BBFILE_PRIORITY_meta-alencon = "6"

LAYERDEPENDS_meta-alencon = "core"
LAYERSERIES_COMPAT_meta-alencon = "dunfell"
```
